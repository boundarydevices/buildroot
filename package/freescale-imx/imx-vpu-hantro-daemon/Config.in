## package/freescale-imx/imx-vpu-hantro-daemon/Config.in
```kconfig
comment "imx-vpu-hantro-daemon needs an i.MX-specific Linux kernel to be built"
	depends on !BR2_LINUX_KERNEL

comment "imx-vpu-hantro needs an i.MX platform with Hantro VPU"
	depends on BR2_LINUX_KERNEL
	depends on !BR2_PACKAGE_FREESCALE_IMX_HAS_VPU_HANTRO

config BR2_PACKAGE_IMX_VPU_HANTRO_DAEMON
	bool "imx-vpu-hantro"
	depends on BR2_LINUX_KERNEL
	depends on BR2_PACKAGE_FREESCALE_IMX_HAS_VPU_HANTRO
	select BR2_PACKAGE_IMX_VPU_HANTRO
	select BR2_PACKAGE_IMX_VPU_HANTRO_VC if BR2_PACKAGE_FREESCALE_IMX_PLATFORM_IMX8MP
	help
	  i.MX Hantro V4L2 Daemon specific for the NXP i.MX SoC
	  integrating a Hantro Video Processing Unit (VPU) such as the
	  i.MX8MQ/i.MX8MM/i.MX8MP.

	  This library is provided by NXP as-is and doesn't have an
	  upstream.
```
